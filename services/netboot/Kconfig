## services/netboot/Kconfig
```kconfig
menuconfig SERVICE_NETBOOT
    bool "Network Booting (Netboot via TFTP/DHCP)"
    default y
    help
      Enables the baremetal netboot service using GEM0/GEM1.

if SERVICE_NETBOOT

config NETBOOT_AUTO_FALLBACK
    bool "Automatic Fallback to Netboot on Boot Failure"
    default y
    help
      Automatically attempts to fetch and execute an image over TFTP if
      local storage media (SD card, eMMC, QSPI) does not contain a valid image.

config NETBOOT_DEFAULT_SERVER_IP
    string "Default TFTP Server IP"
    default "192.168.20.94"
    help
      Fallback IP address of the TFTP server if not supplied via CLI or DHCP next-server.

config NETBOOT_DEFAULT_FILENAME
    string "Default Boot Image Filename"
    default "boot.bin"
    help
      Filename requested from TFTP server if no argument is passed in TinyCLI.

config NETBOOT_DDR_DEST_ADDR
    hex "Destination DDR Load Address"
    default 0x80000000
    help
      Target physical memory address where the downloaded image will be staged.

endif
```

## services/serialboot/Kconfig
```kconfig
config SERVICE_SERIALBOOT
	bool "Serial Boot SFL support"
	default n
        select SERVICE_TINYCLI
	help
        Enable the custom Serial Framing Protocol (SFL) bootloader
        to download and execute bare-metal binaries via UART.
```

## services/spi/Kconfig
```kconfig
config SERVICE_SPI
	bool "Boot from System Controller SPI flash support"
	default n
	help
	  This feature enables booting from a payload stored in the SPI flash
	  connected to the PolarFire SoC System Controller.

	  If you do not know what to do here, say Y.

config SERVICE_SPI_FLASH
	bool "SPI Flash Programming Support (NETBOOT SPI / SERIALBOOT)"
	default y if SERVICE_SPI || SERVICE_NETBOOT || SERVICE_SERIALBOOT
	help
	  Enables external SPI NOR flash erase, program, and verification
	  support for CLI commands (such as NETBOOT SPI and SERIALBOOT).

if SERVICE_SPI_FLASH

choice
	prompt "SPI Flash Controller Backend"
	default SPI_FLASH_CORESPI if BOARD_MPFS_ICICLE_KIT
	default SPI_FLASH_MSS_SPI if BOARD_MPFS_DISCO_KIT
	default SPI_FLASH_CORESPI

config SPI_FLASH_CORESPI
	bool "FPGA Fabric CoreSPI (Board BSP hooks in board_spi.c)"
	help
	  Routes SPI flash transactions through a fabric CoreSPI IP block
	  implemented in boards/<board>/board_spi.c (used on Icicle Kit).

config SPI_FLASH_MSS_SPI
	bool "MSS SPI Peripheral (MPFS HAL MSS_SPI driver)"
	help
	  Routes SPI flash transactions through the hardened MSS SPI0 or
	  MSS SPI1 controller (used on Discovery Kit mikroBUS / expansion).

endchoice

if SPI_FLASH_MSS_SPI

config SPI_FLASH_MSS_SPI_INSTANCE
	int "MSS SPI Controller Instance (0 = SPI0, 1 = SPI1)"
	range 0 1
	default 0

config SPI_FLASH_MSS_SPI_SLAVE
	int "MSS SPI Slave Select Line (0..3)"
	range 0 3
	default 0

config SPI_FLASH_MSS_SPI_CLK_DIV
	int "MSS SPI Clock Divider (even value 2..512)"
	range 2 512
	default 16

endif # SPI_FLASH_MSS_SPI

endif # SERVICE_SPI_FLASH
```

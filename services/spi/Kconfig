## services/spi/Kconfig
```kconfig
choice
	prompt "SPI Flash Boot Support"
	optional
	help
	  Select the SPI flash controller used for booting an HSS payload image.
	  System Controller SPI (SC_SPI) and Board/MSS SPI are mutually exclusive;
	  selecting one automatically disables the other.

config SERVICE_SPI
	bool "Boot from System Controller SPI flash support (SC_SPI)"
	help
	  Enables booting from a payload stored in the dedicated SPI flash
	  connected to the PolarFire SoC System Controller (via MSS_SYS_spi_copy).

config SERVICE_MSS_SPI_BOOT
	bool "Boot from MSS / Board SPI flash support (board_spi.c)"
	select SERVICE_SPI_FLASH
	help
	  Enables booting from an external SPI NOR flash connected to the
	  board SPI controller (boards/<board>/board_spi.c) at offset
	  CONFIG_SERVICE_BOOT_SPI_FLASH_OFFSET (default 0x400).

endchoice

config SERVICE_SPI_FLASH
	bool "SPI Flash Programming Support (YMODEM SPI , SERIALBOOT SPI , NETBOOT SPI )"
	default y if SERVICE_SPI || SERVICE_MSS_SPI_BOOT || SERVICE_NETBOOT || SERVICE_SERIALBOOT
	help
	  Enables external SPI NOR flash erase, program, and verification
	  support via boards/<board>/board_spi.c.
```

## services/spiflash/Kconfig
```kconfig
config SERVICE_SPI_FLASH
	bool "SPI Flash Driver and CLI Support"
	default y if SERVICE_SPI || SERVICE_NETBOOT || SERVICE_SERIALBOOT
	help
	  Enables external SPI NOR flash read, erase, program, and CLI support.


if SERVICE_SPI_FLASH

choice
	prompt "SPI Flash Controller Backend"
	default SPI_FLASH_CORESPI if BOARD_MPFS_ICICLE_KIT
	default SPI_FLASH_MSS_SPI if BOARD_MPFS_DISCO_KIT
	default SPI_FLASH_CORESPI

config SPI_FLASH_CORESPI
	bool "FPGA Fabric CoreSPI (Board BSP hooks in board_spi.c)"

config SPI_FLASH_MSS_SPI
	bool "MSS SPI Peripheral (MPFS HAL MSS_SPI driver)"

config SERVICE_BOOT_SPI_FLASH_OFFSET
	hex "SPI Flash Boot Payload Offset"
	default 0x400
	help
	  Byte offset in external SPI NOR flash where the HSS boot image starts
	  (default 0x400).

endchoice



endif # SERVICE_SPI_FLASH
```
